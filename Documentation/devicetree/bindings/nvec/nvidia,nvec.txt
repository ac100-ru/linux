## Documentation/devicetree/bindings/nvec/nvidia,nvec.txt
```
NVIDIA compliant embedded controller

Required properties:
- compatible : should be "nvidia,nvec-slave".
- reg: the i2c address of the slave controller
- request-gpios : the gpio used for ec request
```
